## base_external/configs/aesd_qemu_defconfig
```kconfig
BR2_CCACHE=y
BR2_CCACHE_DIR="$(TOPDIR)/../../buildroot-ccache"
BR2_FORCE_HOST_BUILD=y
BR2_TARGET_GENERIC_ROOT_PASSWD="root"
BR2_PACKAGE_DROPBEAR=y
BR2_PACKAGE_AESD_ASSIGNMENTS=y
```
